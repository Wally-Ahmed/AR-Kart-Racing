/*
 * ir_tag_codec.h — the AR Kart TV-remote-style 38 kHz IR tag, PURE CODEC.
 *
 * Everything in this file is `static inline`, depends on nothing but <stdint.h>/<stdbool.h>,
 * and is the ONE definition of the on-air format. ir_tag.c includes it to drive the RMT
 * transmitter and the GPIO-edge decoder; a host test compiles it with a plain `cc` and round-
 * trips encode -> edges -> decode with no ESP-IDF in sight. If the format ever changes, it
 * changes here and both sides move together.
 *
 * ============================================================================================
 * THE ON-AIR FORMAT  (normative — this is the wire)
 * ============================================================================================
 * Physical layer
 *   Carrier         38.0 kHz, 1/3 duty, generated by the RMT peripheral's hardware carrier and
 *                   applied to the MARK (logic-high) level of the symbol stream. GPIO14 drives
 *                   the IR LED through 100 Ohm, so MARK = LED lit = carrier burst in the air.
 *   Receiver        TSSP77038 breakout, OUT -> GPIO3. It DEMODULATES: its output is idle HIGH
 *                   and pulls LOW for the duration of a 38 kHz burst. So on GPIO3
 *                   MARK = LOW and SPACE = HIGH, and the decoder only ever sees durations.
 *
 * Coding          pulse-distance, NEC-style: every bit is a fixed-length mark followed by a
 *                 space whose LENGTH carries the bit. Bits are sent MSB first.
 *
 * Frame
 *     HEADER     mark 2400 us,  space 600 us
 *     8 BITS     each:  mark 600 us,  then space 600 us = 0  /  space 1200 us = 1
 *     TRAILER    mark 600 us,  then silence
 *
 *   Frame length: 13 200 us (payload 0x00) .. 18 000 us (payload 0xFF).
 *
 * Payload byte — 8 bits, MSB first
 *     bits 7..4   shooter kart id, 1..15.  0 is INVALID and is never transmitted.
 *     bits 3..0   check = (~id) & 0x0F  — the nibble complement, which is exactly the integrity
 *                 trick NEC uses for its address byte. It catches every single-bit error in
 *                 either nibble and every case where a decode slipped by a whole bit position,
 *                 which are the two ways an IR frame actually goes wrong. A CRC would cost 6-8
 *                 more bits of air time for no gain at this payload size (the Donor-Duel spec's
 *                 CRC-6 frame carried hearts, weapon and sequence; this one carries 4 bits).
 *
 * Burst           one trigger = IR_REPEATS copies of the frame (default 3) separated by
 *                 IR_FRAME_GAP_US (20 ms) of silence. Worst case 3 x 18.0 ms + 3 x 20 ms
 *                 = 114 ms of air time; the receiver decodes whichever copy survives and the
 *                 lockout in ir_tag.c swallows the rest.
 *
 * ============================================================================================
 * DECODE TOLERANCES
 * ============================================================================================
 * A measured duration matches a nominal when it is within max(30 %, 150 us) of it:
 *     header mark  2400 us -> [1680, 3120]
 *     header space  600 us -> [ 420,  780]
 *     bit mark      600 us -> [ 420,  780]
 *     trailer mark  600 us -> [ 420,  780]
 * The bit space is classified over ONE contiguous window [420, 1560] split at 900 us, rather
 * than two windows with a dead band between them: a demodulating receiver stretches marks and
 * shortens spaces by a few tens of microseconds depending on signal strength, and a dead band
 * is just a way to throw away a frame that was perfectly readable.
 *
 * ============================================================================================
 * HOST TEST
 * ============================================================================================
 *     cc -std=c11 -Wall -Wextra -Werror -Imain -o t tools/ir_codec_test.c && ./t
 * ir_encode_intervals() -> the same mark/space list the RMT symbols are built from, and
 * ir_dec_feed() -> the same state machine the ISR's edges are fed through. One round trip
 * covers both halves of the wire.
 */

#pragma once

#include <stdbool.h>
#include <stdint.h>

/* ---- on-air timing, microseconds --------------------------------------------------------- */
#define IR_HDR_MARK_US        2400u
#define IR_HDR_SPACE_US        600u
#define IR_BIT_MARK_US         600u
#define IR_ZERO_SPACE_US       600u
#define IR_ONE_SPACE_US       1200u
#define IR_TRAIL_MARK_US       600u
#define IR_FRAME_GAP_US      20000u   /* silence between the copies inside one burst         */

#define IR_CARRIER_HZ        38000u   /* nominal; the achieved value is reported by `irstat`  */
#define IR_CARRIER_DUTY        0.33f

/* ---- frame geometry ---------------------------------------------------------------------- */
#define IR_PAYLOAD_BITS           8
/* alternating mark,space,...: 1 header pair + 8 bit pairs + 1 trailing mark = 19 intervals.
 * Index parity IS the polarity: even = MARK, odd = SPACE. Both the RMT symbol builder and the
 * synthetic-edge injector rely on that, so do not reorder. */
#define IR_INTERVALS              (2 + 2 * IR_PAYLOAD_BITS + 1)

/* Sum of the MARK intervals in one frame — constant, payload-independent (the payload only
 * changes space lengths). `ircheck` divides the PCNT carrier-edge count by this to measure the
 * carrier frequency on-chip with no instruments. */
#define IR_FRAME_MARK_US      (IR_HDR_MARK_US + IR_PAYLOAD_BITS * IR_BIT_MARK_US + IR_TRAIL_MARK_US)

/* ---- decode tolerance -------------------------------------------------------------------- */
#define IR_TOL_PCT               30u
#define IR_TOL_MIN_US           150u
#define IR_SPACE_SPLIT_US     ((IR_ZERO_SPACE_US + IR_ONE_SPACE_US) / 2u)   /* 900 us */

/* ------------------------------------------------------------------------------------------ */
/* payload                                                                                    */
/* ------------------------------------------------------------------------------------------ */

/* The check nibble for a 4-bit shooter id. */
static inline uint8_t ir_check_nibble(uint8_t id4)
{
    return (uint8_t)((~id4) & 0x0Fu);
}

/* True when this id can be carried: 1..15. Kart 0 and kart >15 cannot be encoded. */
static inline bool ir_id_valid(uint32_t id)
{
    return id >= 1u && id <= 15u;
}

static inline uint8_t ir_payload(uint8_t id4)
{
    return (uint8_t)(((id4 & 0x0Fu) << 4) | ir_check_nibble(id4));
}

static inline uint8_t ir_payload_shooter(uint8_t payload)
{
    return (uint8_t)((payload >> 4) & 0x0Fu);
}

/* Integrity gate: the low nibble must be the complement of the high one, and the shooter id
 * must be a legal kart. A frame of all-zeros or all-ones therefore never validates. */
static inline bool ir_payload_ok(uint8_t payload)
{
    const uint8_t id = ir_payload_shooter(payload);
    return ir_id_valid(id) && ((payload & 0x0Fu) == ir_check_nibble(id));
}

/* ------------------------------------------------------------------------------------------ */
/* encode                                                                                     */
/* ------------------------------------------------------------------------------------------ */

/* Writes the IR_INTERVALS alternating mark/space durations of one frame, MARK at even indices.
 * Returns the count written, or 0 when cap is too small. */
static inline int ir_encode_intervals(uint8_t payload, uint16_t *out, int cap)
{
    if (out == NULL || cap < IR_INTERVALS) {
        return 0;
    }
    int n = 0;
    out[n++] = (uint16_t)IR_HDR_MARK_US;
    out[n++] = (uint16_t)IR_HDR_SPACE_US;
    for (int b = IR_PAYLOAD_BITS - 1; b >= 0; b--) {          /* MSB first */
        out[n++] = (uint16_t)IR_BIT_MARK_US;
        out[n++] = (payload & (1u << b)) ? (uint16_t)IR_ONE_SPACE_US
                                         : (uint16_t)IR_ZERO_SPACE_US;
    }
    out[n++] = (uint16_t)IR_TRAIL_MARK_US;
    return n;
}

/* ------------------------------------------------------------------------------------------ */
/* decode                                                                                     */
/* ------------------------------------------------------------------------------------------ */

typedef enum {
    IR_DEC_NONE  = 0,   /* interval consumed, frame still in progress (or still idle) */
    IR_DEC_FRAME,       /* a complete 8-bit frame is in .payload (integrity NOT checked here) */
    IR_DEC_ABORT,       /* framing violation — the partial frame was thrown away */
} ir_dec_ret_t;

typedef enum {
    IR_ST_IDLE = 0,
    IR_ST_HDR_SPACE,
    IR_ST_BIT_MARK,
    IR_ST_BIT_SPACE,
    IR_ST_TRAIL,
} ir_dec_state_t;

typedef struct {
    uint8_t state;      /* ir_dec_state_t */
    uint8_t nbits;
    uint8_t data;       /* bits accumulated so far */
    uint8_t payload;    /* valid for exactly one call, when IR_DEC_FRAME is returned */
} ir_dec_t;

static inline void ir_dec_reset(ir_dec_t *d)
{
    d->state = (uint8_t)IR_ST_IDLE;
    d->nbits = 0;
    d->data  = 0;
}

static inline uint32_t ir_tol(uint32_t nominal)
{
    const uint32_t t = (nominal * IR_TOL_PCT) / 100u;
    return (t < IR_TOL_MIN_US) ? IR_TOL_MIN_US : t;
}

static inline bool ir_near(uint32_t dur, uint32_t nominal)
{
    const uint32_t t = ir_tol(nominal);
    return (dur + t >= nominal) && (dur <= nominal + t);
}

/*
 * Feed ONE completed interval.
 *
 *   dur_us   its length
 *   is_mark  true  = a MARK just ended (on GPIO3: the line went back HIGH)
 *            false = a SPACE just ended (the line went LOW, a mark is starting)
 *
 * The decoder is duration-only and has no clock of its own, which is what lets the `irtest`
 * console hook replay a synthetic burst through the identical code path as the real ISR.
 *
 * On a framing violation it returns IR_DEC_ABORT and resynchronises IMMEDIATELY: the offending
 * interval is re-tested as a header mark before returning, so a frame that begins while a
 * corrupted one is still being parsed is not lost as well.
 */
static inline ir_dec_ret_t ir_dec_feed(ir_dec_t *d, uint32_t dur_us, bool is_mark)
{
    switch ((ir_dec_state_t)d->state) {
    case IR_ST_IDLE:
        if (is_mark && ir_near(dur_us, IR_HDR_MARK_US)) {
            d->state = (uint8_t)IR_ST_HDR_SPACE;
        }
        return IR_DEC_NONE;                    /* idle noise is not an abort */

    case IR_ST_HDR_SPACE:
        if (!is_mark && ir_near(dur_us, IR_HDR_SPACE_US)) {
            d->state = (uint8_t)IR_ST_BIT_MARK;
            d->nbits = 0;
            d->data  = 0;
            return IR_DEC_NONE;
        }
        break;

    case IR_ST_BIT_MARK:
        if (is_mark && ir_near(dur_us, IR_BIT_MARK_US)) {
            d->state = (uint8_t)IR_ST_BIT_SPACE;
            return IR_DEC_NONE;
        }
        break;

    case IR_ST_BIT_SPACE:
        if (!is_mark) {
            const uint32_t lo = IR_ZERO_SPACE_US - ir_tol(IR_ZERO_SPACE_US);   /*  420 */
            const uint32_t hi = IR_ONE_SPACE_US  + ir_tol(IR_ONE_SPACE_US);    /* 1560 */
            if (dur_us >= lo && dur_us <= hi) {
                const uint8_t bit = (dur_us >= IR_SPACE_SPLIT_US) ? 1u : 0u;
                d->data = (uint8_t)((d->data << 1) | bit);
                d->nbits++;
                d->state = (d->nbits >= IR_PAYLOAD_BITS) ? (uint8_t)IR_ST_TRAIL
                                                         : (uint8_t)IR_ST_BIT_MARK;
                return IR_DEC_NONE;
            }
        }
        break;

    case IR_ST_TRAIL:
        if (is_mark && ir_near(dur_us, IR_TRAIL_MARK_US)) {
            d->payload = d->data;
            ir_dec_reset(d);
            return IR_DEC_FRAME;
        }
        break;

    default:
        break;
    }

    /* ---- framing violation ---- */
    ir_dec_reset(d);
    if (is_mark && ir_near(dur_us, IR_HDR_MARK_US)) {
        d->state = (uint8_t)IR_ST_HDR_SPACE;   /* immediate resync on a back-to-back frame */
    }
    return IR_DEC_ABORT;
}
